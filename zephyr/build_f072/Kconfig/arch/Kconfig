## zephyr/build_f072/Kconfig/arch/Kconfig
```kconfig
# Load Zephyr Arch Kconfig descriptions.
osource "C:/Users/justin/zephyrproject/zephyr/arch/rx/Kconfig"
osource "C:/Users/justin/zephyrproject/zephyr/arch/x86/Kconfig"
osource "C:/Users/justin/zephyrproject/zephyr/arch/xtensa/Kconfig"
osource "C:/Users/justin/zephyrproject/zephyr/arch/sparc/Kconfig"
osource "C:/Users/justin/zephyrproject/zephyr/arch/riscv/Kconfig"
osource "C:/Users/justin/zephyrproject/zephyr/arch/posix/Kconfig"
osource "C:/Users/justin/zephyrproject/zephyr/arch/openrisc/Kconfig"
osource "C:/Users/justin/zephyrproject/zephyr/arch/mips/Kconfig"
osource "C:/Users/justin/zephyrproject/zephyr/arch/arm64/Kconfig"
osource "C:/Users/justin/zephyrproject/zephyr/arch/arm/Kconfig"
osource "C:/Users/justin/zephyrproject/zephyr/arch/arc/Kconfig"
```

## zephyr/build_f072/Kconfig/boards/Kconfig
```kconfig
# Load Zephyr board Kconfig descriptions.
osource "C:/Users/justin/zephyrproject/zephyr/boards/st/nucleo_f072rb/Kconfig"
```

## zephyr/build_f072/Kconfig/boards/Kconfig.defconfig
```kconfig
# Load Zephyr board defconfig descriptions.
osource "C:/Users/justin/zephyrproject/zephyr/boards/st/nucleo_f072rb/Kconfig.defconfig"
```

## zephyr/build_f072/Kconfig/boards/Kconfig.nucleo_f072rb.tmp
```kconfig
# Load board Kconfig descriptions.
osource "C:/Users/justin/zephyrproject/zephyr/boards/st/nucleo_f072rb/Kconfig.nucleo_f072rb"
```

## zephyr/build_f072/Kconfig/boards/Kconfig.sysbuild.tmp
```kconfig
# Load Sysbuild board Kconfig descriptions.
osource "C:/Users/justin/zephyrproject/zephyr/boards/st/nucleo_f072rb/Kconfig.sysbuild"
```

## zephyr/build_g474/Kconfig/boards/Kconfig
```kconfig
# Load Zephyr board Kconfig descriptions.
osource "C:/Users/justin/zephyrproject/zephyr/boards/st/nucleo_g474re/Kconfig"
```

## zephyr/build_g474/Kconfig/boards/Kconfig.defconfig.tmp
```kconfig
# Load Zephyr board defconfig descriptions.
osource "C:/Users/justin/zephyrproject/zephyr/boards/st/nucleo_g474re/Kconfig.defconfig"
```

## zephyr/build_g474/Kconfig/boards/Kconfig.nucleo_g474re.tmp
```kconfig
# Load board Kconfig descriptions.
osource "C:/Users/justin/zephyrproject/zephyr/boards/st/nucleo_g474re/Kconfig.nucleo_g474re"
```

## zephyr/build_g474/Kconfig/boards/Kconfig.sysbuild.tmp
```kconfig
# Load Sysbuild board Kconfig descriptions.
osource "C:/Users/justin/zephyrproject/zephyr/boards/st/nucleo_g474re/Kconfig.sysbuild"
```
